#pragma once

#include <stdint.h>

#include "nrf54l15_regs.h"

namespace xiao_nrf54l15 {

// Clock task/event control is implemented by CLOCK. OSCILLATORS only contains
// trim registers and must not be used for start/stop task access.
class Oscillators {
 public:
  enum class LfclkSource : uint32_t {
    kLfrc = 0,
    kLfxo = 1,
    kLfSynt = 2,
  };

  inline static void setLfclkSource(LfclkSource source) {
    writeReg(kLfclkSrc, static_cast<uint32_t>(source));
  }

  inline static LfclkSource getLfclkSource() {
    return static_cast<LfclkSource>(readReg(kLfclkSrc) & 0x3UL);
  }

  inline static LfclkSource getLfclkSourceCopy() {
    return static_cast<LfclkSource>(readReg(kLfclkSrcCopy) & 0x3UL);
  }

  inline static void startLfclk() { writeReg(kTasksLfclkStart, 1); }
  inline static void stopLfclk() { writeReg(kTasksLfclkStop, 1); }

  inline static bool lfclkStartTriggered() {
    return (readReg(kLfclkRun) & 1UL) != 0;
  }

  inline static bool lfclkRunning() {
    return (readReg(kLfclkStat) & kStateMask) != 0;
  }

  inline static bool lfclkStopped(bool clear = true) {
    (void)clear;
    return !lfclkRunning();
  }

  inline static bool lfclkStarted(bool clear = true) {
    return event(kEventsLfclkStarted, clear);
  }

  inline static void startHfxo() { writeReg(kTasksXoStart, 1); }
  inline static void stopHfxo() { writeReg(kTasksXoStop, 1); }
  inline static void tuneHfxo() { writeReg(kTasksXoTune, 1); }

  inline static bool hfxoStartTriggered() {
    return (readReg(kXoRun) & 1UL) != 0;
  }

  inline static bool hfxoRunning() {
    return (readReg(kXoStat) & kStateMask) != 0;
  }

  inline static bool hfxoTuned(bool clear = true) {
    return event(kEventsXoTuned, clear);
  }

  inline static bool hfxoTuneFailed(bool clear = true) {
    return event(kEventsXoTuneFailed, clear);
  }

  inline static bool hfxoTuneError(bool clear = true) {
    return event(kEventsXoTuneError, clear);
  }

  inline static bool hfxoStarted(bool clear = true) {
    return event(kEventsXoStarted, clear);
  }

  inline static bool hfxoStopped(bool clear = true) {
    (void)clear;
    return !hfxoRunning();
  }

  inline static void startPl1() { writeReg(kTasksPllStart, 1); }
  inline static void stopPl1() { writeReg(kTasksPllStop, 1); }
  inline static void startPll() { startPl1(); }
  inline static void stopPll() { stopPl1(); }

  inline static bool pllRunning() {
    return (readReg(kPllStat) & kStateMask) != 0;
  }

  inline static bool pllStarted(bool clear = true) {
    return event(kEventsPllStarted, clear);
  }

  enum class HfclkSource : uint32_t {
    kRcOsc = 0,
    kHfxo = 1,
    kSynt = 2,
  };

  // There is no CLOCK.HFCLKSRC register on nRF54L. Retain the compatibility
  // setter as software state. HFCLK is generated by the PLL; XOSTART selects
  // the accurate crystal reference by making the PLL lock to HFXO.
  inline static void setHfclkSource(HfclkSource source) {
    requestedHfclkSource() = source;
  }

  inline static constexpr bool hfclkSourceSupported(HfclkSource source) {
    return source != HfclkSource::kSynt;
  }

  inline static HfclkSource getHfclkSourceCopy() {
    return hfxoRunning() ? HfclkSource::kHfxo : HfclkSource::kRcOsc;
  }

  inline static void startHfclk() {
    const HfclkSource source = requestedHfclkSource();
    if (!hfclkSourceSupported(source)) return;
    writeReg(kEventsPllStarted, 0);
    if (source == HfclkSource::kHfxo) {
      writeReg(kEventsXoStarted, 0);
    }
    // PLLSTART is a keep-running request, not a runtime frequency change.
    // nRF54L anomaly 39 requires it before XOSTART.
    startPll();
    if (source == HfclkSource::kHfxo) startHfxo();
  }

  inline static void stopHfclk() {
    const HfclkSource source = requestedHfclkSource();
    if (!hfclkSourceSupported(source)) return;
    // Pair anomaly-39 shutdown in the required XOSTOP, PLLSTOP order.
    if (source == HfclkSource::kHfxo) stopHfxo();
    stopPll();
  }

  inline static bool hfclkStarted(bool clear = true) {
    const HfclkSource source = requestedHfclkSource();
    if (!hfclkSourceSupported(source)) return false;
    if (source != HfclkSource::kHfxo) return pllStarted(clear);

    const bool xoStarted = event(kEventsXoStarted, false);
    const bool pllHasStarted = event(kEventsPllStarted, false);
    if (clear) {
      if (xoStarted) writeReg(kEventsXoStarted, 0);
      if (pllHasStarted) writeReg(kEventsPllStarted, 0);
    }
    return xoStarted && pllHasStarted;
  }

  inline static bool hfclkStopped(bool clear = true) {
    (void)clear;
    const HfclkSource source = requestedHfclkSource();
    if (!hfclkSourceSupported(source)) return false;
    return source == HfclkSource::kHfxo
               ? (!hfxoRunning() && !pllRunning())
               : !pllRunning();
  }

  inline static bool hfclkRunning() {
    const HfclkSource source = requestedHfclkSource();
    if (!hfclkSourceSupported(source)) return false;
    return pllRunning() &&
           (source != HfclkSource::kHfxo || hfxoRunning());
  }

  inline static void enableHfxoStartedInterrupt(bool enable = true) {
    writeReg(enable ? kIntenSet : kIntenClr, 1UL << 0);
  }

  inline static void enableLfclkStartedInterrupt(bool enable = true) {
    writeReg(enable ? kIntenSet : kIntenClr, 1UL << 2);
  }

  inline static uint32_t readReg(uint32_t offset) {
    return *reinterpret_cast<const volatile uint32_t*>(kBase + offset);
  }

  inline static void writeReg(uint32_t offset, uint32_t value) {
    *reinterpret_cast<volatile uint32_t*>(kBase + offset) = value;
  }

 private:
  static constexpr uintptr_t kBase = nrf54l15::CLOCK_BASE;
  static constexpr uint32_t kTasksXoStart = 0x000;
  static constexpr uint32_t kTasksXoStop = 0x004;
  static constexpr uint32_t kTasksPllStart = 0x008;
  static constexpr uint32_t kTasksPllStop = 0x00C;
  static constexpr uint32_t kTasksLfclkStart = 0x010;
  static constexpr uint32_t kTasksLfclkStop = 0x014;
  static constexpr uint32_t kTasksXoTune = 0x01C;
  static constexpr uint32_t kEventsXoStarted = 0x100;
  static constexpr uint32_t kEventsPllStarted = 0x104;
  static constexpr uint32_t kEventsLfclkStarted = 0x108;
  static constexpr uint32_t kEventsXoTuned = 0x110;
  static constexpr uint32_t kEventsXoTuneError = 0x114;
  static constexpr uint32_t kEventsXoTuneFailed = 0x118;
  static constexpr uint32_t kIntenSet = 0x304;
  static constexpr uint32_t kIntenClr = 0x308;
  static constexpr uint32_t kXoRun = 0x408;
  static constexpr uint32_t kXoStat = 0x40C;
  static constexpr uint32_t kPllStat = 0x42C;
  static constexpr uint32_t kLfclkSrc = 0x440;
  static constexpr uint32_t kLfclkRun = 0x448;
  static constexpr uint32_t kLfclkStat = 0x44C;
  static constexpr uint32_t kLfclkSrcCopy = 0x450;
  static constexpr uint32_t kStateMask = 1UL << 16;

  inline static bool event(uint32_t offset, bool clear) {
    const bool set = readReg(offset) != 0;
    if (set && clear) writeReg(offset, 0);
    return set;
  }

  inline static HfclkSource& requestedHfclkSource() {
    static HfclkSource source = HfclkSource::kRcOsc;
    return source;
  }
};

}  // namespace xiao_nrf54l15
