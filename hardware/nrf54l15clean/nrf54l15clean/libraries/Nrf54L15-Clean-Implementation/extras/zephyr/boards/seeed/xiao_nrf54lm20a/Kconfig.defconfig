## hardware/nrf54l15clean/nrf54l15clean/libraries/Nrf54L15-Clean-Implementation/extras/zephyr/boards/seeed/xiao_nrf54lm20a/Kconfig.defconfig
```kconfig
# Copyright (c) 2026
# SPDX-License-Identifier: Apache-2.0

if BOARD_XIAO_NRF54LM20A_NRF54LM20A_CPUAPP

config HAS_BT_CTLR
	default BT

config HW_STACK_PROTECTION
	default ARCH_HAS_STACK_PROTECTION

endif # BOARD_XIAO_NRF54LM20A_NRF54LM20A_CPUAPP
```

## hardware/nrf54l15clean/nrf54l15clean/libraries/Nrf54L15-Clean-Implementation/extras/zephyr/boards/seeed/xiao_nrf54lm20a/Kconfig.xiao_nrf54lm20a
```kconfig
# Copyright (c) 2026
# SPDX-License-Identifier: Apache-2.0

config BOARD_XIAO_NRF54LM20A
	select SOC_NRF54LM20A_CPUAPP if BOARD_XIAO_NRF54LM20A_NRF54LM20A_CPUAPP
```

## hardware/nrf54l15clean/nrf54l15clean/libraries/Nrf54L15-Clean-Implementation/extras/zephyr/boards/seeed/xiao_nrf54lm20a/board.yml
```yaml
board:
  name: xiao_nrf54lm20a
  full_name: XIAO nRF54LM20A
  vendor: seeed
  socs:
    - name: nrf54lm20a
```

## hardware/nrf54l15clean/nrf54l15clean/libraries/Nrf54L15-Clean-Implementation/extras/zephyr/boards/seeed/xiao_nrf54lm20a/xiao_nrf54lm20a_nrf54lm20a_cpuapp_defconfig
```kconfig
# Copyright (c) 2026
# SPDX-License-Identifier: Apache-2.0

CONFIG_SERIAL=y
CONFIG_CONSOLE=y
CONFIG_UART_CONSOLE=y
CONFIG_GPIO=y
CONFIG_ARM_MPU=y
CONFIG_HW_STACK_PROTECTION=y
CONFIG_NULL_POINTER_EXCEPTION_DETECTION_NONE=y
CONFIG_CACHE_MANAGEMENT=y
CONFIG_EXTERNAL_CACHE=y
CONFIG_NRF_GRTC_START_SYSCOUNTER=y
CONFIG_REGULATOR=y
```
