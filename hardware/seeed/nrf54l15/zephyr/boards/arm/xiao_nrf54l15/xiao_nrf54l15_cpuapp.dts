/*
 * Copyright (c) 2024 Seeed Studio
 * SPDX-License-Identifier: Apache-2.0
 */

/dts-v1/;
#include <nordic/nrf54l15_cpuapp.dtsi>
#include "xiao_nrf54l15_common.dtsi"

/ {
    model = "Seeed Studio Xiao nRF54L15";
    compatible = "seeed,xiao-nrf54l15";

    chosen {
        zephyr,console = &uart20;
        zephyr,shell-uart = &uart20;
        zephyr,sram = &sram0_image;
        zephyr,flash = &mram1;
        zephyr,code-partition = &slot0_partition;
    };
};
