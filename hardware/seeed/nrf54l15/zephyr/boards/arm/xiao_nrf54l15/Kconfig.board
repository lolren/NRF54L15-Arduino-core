## hardware/seeed/nrf54l15/zephyr/boards/arm/xiao_nrf54l15/Kconfig.board
```kconfig
# SPDX-License-Identifier: Apache-2.0

config BOARD_XIAO_NRF54L15
    bool "Seeed Studio Xiao nRF54L15"
    depends on SOC_NRF54L15_ENGA_CPUAPP
```

## hardware/seeed/nrf54l15/zephyr/boards/arm/xiao_nrf54l15/Kconfig.defconfig
```kconfig
# SPDX-License-Identifier: Apache-2.0

if BOARD_XIAO_NRF54L15

config BOARD
    default "xiao_nrf54l15"

endif
```
